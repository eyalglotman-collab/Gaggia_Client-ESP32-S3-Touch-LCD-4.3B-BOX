## sdkconfig.defaults
```kconfig
# ESP32-S3-Touch-LCD-4.3b-Box Minimal Configuration
# ESP-IDF Kconfig defaults (without BSP component)

# Chip Configuration
CONFIG_IDF_TARGET="esp32s3"

# Flash Configuration  
CONFIG_ESPTOOLPY_FLASHMODE_QIO=y
CONFIG_ESPTOOLPY_FLASHSIZE_16MB=y
CONFIG_PARTITION_TABLE_CUSTOM=y

# Performance
CONFIG_COMPILER_OPTIMIZATION_PERF=y
CONFIG_ESP_DEFAULT_CPU_FREQ_MHZ_240=y

# PSRAM Configuration (8/16MB)
CONFIG_SPIRAM=y
CONFIG_SPIRAM_MODE_OCT=y
CONFIG_SPIRAM_FETCH_INSTRUCTIONS=y
CONFIG_SPIRAM_RODATA=y
CONFIG_SPIRAM_SPEED_80M=y

# Cache Configuration
CONFIG_ESP32S3_DATA_CACHE_LINE_64B=y
CONFIG_LCD_RGB_RESTART_IN_VSYNC=y

# FreeRTOS Tick Rate
CONFIG_FREERTOS_HZ=1000

# LVGL Configuration
CONFIG_LV_CONF_SKIP=y
CONFIG_LV_OS_FREERTOS=y
CONFIG_LV_DRAW_SW_DRAW_UNIT_CNT=2

# LVGL Color Configuration  
CONFIG_LV_COLOR_DEPTH_16=y

# LVGL Memory Configuration
CONFIG_LV_USE_CLIB_MALLOC=y
CONFIG_LV_USE_CLIB_SPRINTF=y
CONFIG_LV_USE_CLIB_STRING=y

# LVGL Font Configuration
CONFIG_LV_FONT_MONTSERRAT_12=y
CONFIG_LV_FONT_MONTSERRAT_16=y
CONFIG_LV_FONT_MONTSERRAT_20=y
CONFIG_LV_FONT_MONTSERRAT_28=y

# LVGL Widget Support
CONFIG_LV_USE_SWITCH=y
CONFIG_LV_USE_LABEL=y

# LVGL Observer
CONFIG_LV_USE_OBSERVER=y

# Touch I2C pins are defined in main/hardware_init.c (SCL=20, SDA=19)
```
